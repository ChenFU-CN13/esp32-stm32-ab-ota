# file: LVGL_RTOS_DOME5.ioc
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FREERTOS.Tasks01=defaultTask,24,128,StartDefaultTask,Default,NULL,Dynamic,NULL,NULL
Mcu.Family=STM32F4
Mcu.Name=STM32F407Z(E-G)Tx
Mcu.Package=LQFP144
NVIC.PriorityGroup=NVIC_PRIORITYGROUP_4
NVIC.TIM7_IRQn=true\:15\:0\:false\:false\:true\:false\:false\:true\:true
NVIC.TimeBase=TIM7_IRQn
NVIC.TimeBaseIP=TIM7
PA13.Mode=Serial_Wire
PA13.Signal=SYS_JTMS-SWDIO
PA14.Mode=Serial_Wire
PA14.Signal=SYS_JTCK-SWCLK
PC14-OSC32_IN.Mode=LSE-External-Oscillator
PC14-OSC32_IN.Signal=RCC_OSC32_IN
PC15-OSC32_OUT.Mode=LSE-External-Oscillator
PC15-OSC32_OUT.Signal=RCC_OSC32_OUT
PH0-OSC_IN.Mode=HSE-External-Oscillator
PH0-OSC_IN.Signal=RCC_OSC_IN
PH1-OSC_OUT.Mode=HSE-External-Oscillator
PH1-OSC_OUT.Signal=RCC_OSC_OUT
ProjectManager.HeapSize=0x800
ProjectManager.StackSize=0x1000
ProjectManager.TargetToolchain=MDK-ARM V5
RCC.48MHZClocksFreq_Value=84000000
RCC.AHBFreq_Value=168000000
RCC.APB1CLKDivider=RCC_HCLK_DIV4
RCC.APB1Freq_Value=42000000
RCC.APB1TimFreq_Value=84000000
RCC.APB2CLKDivider=RCC_HCLK_DIV2
RCC.APB2Freq_Value=84000000
RCC.APB2TimFreq_Value=168000000
RCC.CortexFreq_Value=168000000
RCC.HCLKFreq_Value=168000000
RCC.HSE_VALUE=8000000
RCC.HSI_VALUE=16000000
RCC.PLLM=4
RCC.PLLN=168
RCC.PLLSourceVirtual=RCC_PLLSOURCE_HSE
RCC.SYSCLKFreq_VALUE=168000000
RCC.SYSCLKSource=RCC_SYSCLKSOURCE_PLLCLK
RCC.VCOOutputFreq_Value=336000000
VP_FREERTOS_VS_CMSIS_V2.Mode=CMSIS_V2
VP_SYS_VS_tim7.Mode=TIM7
board=custom

// file: Core/Src/main.c
#include "main.h"
#include "cmsis_os.h"
#include "gpio.h"
#include "fan_pwm.h"

void SystemClock_Config(void);
void MX_FREERTOS_Init(void);

/* USER CODE BEGIN 0 */

/* 与Bootloader保持相同IWDG配置，避免跳转交接时出现超时窗口突变。 */
#define APP_IWDG_PRESCALER              4U      //PR  4 = 64 分频，超时约 5s，这里写4是对的，因为二进制是100，解码后就是64
#define APP_IWDG_RELOAD                 2499U   //重装载计数值
#define APP_IWDG_UPDATE_TIMEOUT         100U    //看门狗超时时间

//static IWDG_HandleTypeDef hiwdg_app;
//
//HAL_StatusTypeDef Watchdog_Init(void)
//{
//  	__HAL_DBGMCU_FREEZE_IWDG();             //调试保护：断点暂停CPU时IWDG也暂停，防止调试中被狗咬
//    hiwdg_app.Instance = IWDG;
//    hiwdg_app.Init.Prescaler = APP_IWDG_PRESCALER;
//    hiwdg_app.Init.Reload = APP_IWDG_RELOAD;
//    return HAL_IWDG_Init(&hiwdg_app);
//}

//上面是更简单的HAL库写法，下面是寄存器写法

/**
 * @brief 初始化正式APP独立看门狗。
 * @return HAL_OK-初始化成功；HAL_TIMEOUT-配置寄存器更新超时。
 * @note 若由Bootloader跳转而来，本函数会接管已运行的IWDG；冷启动时则主动启动IWDG。
 */
HAL_StatusTypeDef APP_Watchdog_Init(void)
{
	uint32_t start_tick;

	__HAL_DBGMCU_FREEZE_IWDG();             //调试保护：断点暂停CPU时IWDG也暂停，防止调试中被狗咬
	IWDG->KR = 0xCCCCU;                     //启动独立看门狗(硬件内部打开LSI时钟源)
	IWDG->KR = 0x5555U;                     //解锁PR/RL的写保护
	IWDG->PR = APP_IWDG_PRESCALER;          //设置分频系数
	IWDG->RLR = APP_IWDG_RELOAD;            //设置重装值

	start_tick = HAL_GetTick();
	while ((IWDG->SR & (IWDG_SR_PVU | IWDG_SR_RVU)) != 0U)  //这里是等待将预分频和重装值设置完成，PVU对应PR,RVU对应RLR
	{
		if ((HAL_GetTick() - start_tick) >= APP_IWDG_UPDATE_TIMEOUT)
		{
			return HAL_TIMEOUT;
		}
	}

	IWDG->KR = 0xAAAAU; //喂第一次狗，⑦喂第一口，计数器从2499开始重新递减
	return HAL_OK;
}

/**
 * @brief 刷新正式APP独立看门狗。
 * @return 无。
 * @note 写入重装载键不会在冷启动时自行启动IWDG，可安全用于Bootloader跳转早期接管。
 */
void APP_Watchdog_Refresh(void)
{
	IWDG->KR = 0xAAAAU;
  //(void)HAL_IWDG_Refresh(&hiwdg_app);   //HAL库写法
}

/* USER CODE END 0 */

int main(void)
{
/* USER CODE BEGIN 1 */

    /*
    * 正式OTA模式下，APP固定运行在0x08010000。
    * 必须在HAL_Init()前切换向量表，避免HAL初始化期间产生中断时跳回Bootloader向量表。
    */
    SCB->VTOR = FLASH_BASE | 0x00010000U;
    __DSB();
    __ISB();

    /*
    * Bootloader已经启动IWDG，跳转APP后IWDG不会停止。
    * APP必须尽早喂一次狗，防止后续时钟和外设初始化时间过长导致复位。
    */
    APP_Watchdog_Refresh();

/* USER CODE END 1 */

  /* MCU Configuration--------------------------------------------------------*/

  /* Reset of all peripherals, Initializes the Flash interface and the Systick. */
  HAL_Init();

  /* USER CODE BEGIN Init */

  /*
   * Bootloader跳转前关闭了全局中断，跳转到APP后该状态不会自动恢复。
   * 此时APP向量表和HAL基础环境已经就绪，可以重新开启全局中断。
   */
  __enable_irq();

  /* USER CODE END Init */

  /* Configure the system clock */
  SystemClock_Config();
	if (APP_Watchdog_Init() != HAL_OK)
	{
		Error_Handler();
	}

	MX_GPIO_Init();
	APP_Watchdog_Refresh();     //看门狗喂狗
	delay_init();
	usart_init(115200);//注意:这个是串口1
	USART2_DMA1_Init();
	USART2_Init(115200);
	USART3_Init(9600);
	APP_Watchdog_Refresh();     //看门狗喂狗
	sram_init();
	FAN_PWM_Init();
	APP_Watchdog_Refresh();     //看门狗喂狗

	printf("============================= \r\n");
	printf("enter A code is successfully! \r\n");
  //printf("调试:该固件版本为v2.0.0! \r\n");
  //printf("调试:该固件版本为v2.0.2! \r\n");
  //printf("调试:该固件版本为v2.0.3，更新内容：使用累计式环形缓冲区! \r\n");
  //printf("调试:该固件版本为2.0.5，更新内容：APP与bootloader采用累计式环形缓冲区! \r\n");
	//printf("调试:该固件版本为v2.0.7，用于测试Python脚本! \r\n");
  printf("调试:该固件版本为v2.0.8，用于ESP32 OTA回归测试!\r\n");
  printf("[IWDG] APP已接管，超时限制约5000 ms\r\n");
	printf("============================= \r\n");

  /* Init scheduler */
  osKernelInitialize();  /* Call init function for freertos objects (in freertos.c) */
	APP_Watchdog_Refresh();   //看门狗喂狗
  MX_FREERTOS_Init();
	APP_Watchdog_Refresh();   //看门狗喂狗

  /* Start scheduler */
  osKernelStart();    //开启调度器
  /* We should never get here as control is now taken by the scheduler */
  /* Infinite loop */
  while (1)
  {

  }
}

void SystemClock_Config(void)
{
  RCC_OscInitTypeDef RCC_OscInitStruct = {0};
  RCC_ClkInitTypeDef RCC_ClkInitStruct = {0};

  /** Configure the main internal regulator output voltage
  */
  __HAL_RCC_PWR_CLK_ENABLE();
  __HAL_PWR_VOLTAGESCALING_CONFIG(PWR_REGULATOR_VOLTAGE_SCALE1);

  /** Initializes the RCC Oscillators according to the specified parameters
  * in the RCC_OscInitTypeDef structure.
  */
  RCC_OscInitStruct.OscillatorType = RCC_OSCILLATORTYPE_HSE;
  RCC_OscInitStruct.HSEState = RCC_HSE_ON;
  RCC_OscInitStruct.PLL.PLLState = RCC_PLL_ON;
  RCC_OscInitStruct.PLL.PLLSource = RCC_PLLSOURCE_HSE;
  RCC_OscInitStruct.PLL.PLLM = 4;
  RCC_OscInitStruct.PLL.PLLN = 168;
  RCC_OscInitStruct.PLL.PLLP = RCC_PLLP_DIV2;
  RCC_OscInitStruct.PLL.PLLQ = 4;
  if (HAL_RCC_OscConfig(&RCC_OscInitStruct) != HAL_OK)
  {
    Error_Handler();
  }

  /** Initializes the CPU, AHB and APB buses clocks
  */
  RCC_ClkInitStruct.ClockType = RCC_CLOCKTYPE_HCLK|RCC_CLOCKTYPE_SYSCLK
                              |RCC_CLOCKTYPE_PCLK1|RCC_CLOCKTYPE_PCLK2;
  RCC_ClkInitStruct.SYSCLKSource = RCC_SYSCLKSOURCE_PLLCLK;
  RCC_ClkInitStruct.AHBCLKDivider = RCC_SYSCLK_DIV1;
  RCC_ClkInitStruct.APB1CLKDivider = RCC_HCLK_DIV4;
  RCC_ClkInitStruct.APB2CLKDivider = RCC_HCLK_DIV2;

  if (HAL_RCC_ClockConfig(&RCC_ClkInitStruct, FLASH_LATENCY_5) != HAL_OK)
  {
    Error_Handler();
  }
}

/**
 * @brief  定时器回调函数
 * @param   对象句柄
 * @retval   无
 */
void HAL_TIM_PeriodElapsedCallback(TIM_HandleTypeDef *htim)
{
    /*
     * 工程将 TIM7 配置为 HAL 的 1 ms 时基。
     * HAL_GetTick()、UART ACK 超时和 HAL 内部超时都依赖此处递增 uwTick。
     * FreeRTOS 使用 SysTick 维护任务节拍，因此不能依赖 SysTick 来驱动 HAL 时基。
     */
    if (htim->Instance == TIM7)
    {
        HAL_IncTick();
    }
    else if (htim->Instance == TIM6)
    {
//        lv_tick_inc(1);
    }
}

void Error_Handler(void)
{
  /* USER CODE BEGIN Error_Handler_Debug */
  /* User can add his own implementation to report the HAL error return state */
  __disable_irq();
  while (1)
  {
		printf("Init_fail");
  }
  /* USER CODE END Error_Handler_Debug */
}

// file: Core/Src/freertos.c
/* USER CODE END Header */

#include "FreeRTOS.h"
#include "task.h"
#include "main.h"
#include "cmsis_os.h"
#include "./SYSTEM/delay/delay.h"
#include "./SYSTEM/usart/usart.h"
#include "lvgl.h"                // 包含LVGL核心头文件
#include "lv_port_disp.h"        // LVGL显示接口初始化
#include "lv_port_indev.h"       // LVGL输入设备接口初始化

//#include "lv_demo_music.h"

/* USER CODE BEGIN Includes */
#include "gui_guider.h"
#include "events_init.h"
#include "custom.h"
#include "APP_Tasks.h"
#include "alarm_engine.h"
#include "uart2_comm.h"
#include <stdio.h>

#define APP_UI_VALUE_LOG_PERIOD_MS 2000UL
/* USER CODE END Includes */

lv_ui guider_ui;//LVGL对象UI句柄

/***************LVGL UI 任务声明参数******************/
osThreadId_t defaultTaskHandle;
const osThreadAttr_t defaultTask_attributes = {
  .name = "defaultTask",
  .stack_size = 1024 * 8,
  .priority = osPriorityLow2,//10
};

/* USER CODE BEGIN FunctionPrototypes */
void StartDefaultTask(void *argument);
void MX_FREERTOS_Init(void);
static void APP_UI_UpdateSensorValue(lv_obj_t *label, uint8_t valid,
                                     uint16_t value);
static void APP_UI_UpdateSensorX10(lv_obj_t *label, uint8_t valid,
                                   int32_t value_x10);
/* USER CODE END FunctionPrototypes */

/**
  * @brief  FreeRTOS初始化函数
  * @param  None
  * @retval None
  */
void MX_FREERTOS_Init(void) {
  /* USER CODE BEGIN Init */
    lv_init();                                          /* LVGL系统初始化 */
    lv_port_disp_init();                                /* LVGL显示接口初始化，必须在lv_init()之后调用 */
    lv_port_indev_init();                               /* LVGL输入设备接口初始化，必须在lv_init()之后调用 */

	/*LVGL_APP_GUI初始化*/
	setup_ui(&guider_ui);		//首页页面初始化，注意:设置页面是在点击设置按钮后才创建
	events_init(&guider_ui);	//LVGL事件初始化
	custom_init(&guider_ui);	//UI控件初始化
	/*APP_GUI初始化*/

	AppTasks_Create();//APP传感器任务启动

	UART2_Comm_Start();//USART2通讯任务：业务ACK和OTA通知统一在此处理

  /* USER CODE END Init */

  /* 创建defaultTask线程 */
  defaultTaskHandle = osThreadNew(StartDefaultTask, NULL, &defaultTask_attributes);

}

/**
 * @brief 根据数据有效状态刷新单个传感器数值标签。
 * @param label LVGL数值标签对象。
 * @param valid 1表示当前数据有效，0表示传感器未就绪或读取失败。
 * @param value 当前传感器数值。
 * @return 无。
 * @note 无效时显示NC；精简数字字体缺少的N和C由Montserrat 22字体回退显示。
 */
static void APP_UI_UpdateSensorValue(lv_obj_t *label, uint8_t valid,
                                     uint16_t value)
{
    if (valid != 0U)
    {
        lv_label_set_text_fmt(label, "%u", (unsigned int)value);
    }
    else
    {
        lv_label_set_text(label, "NC");
    }
}

/**
 * @brief 按1位小数刷新温湿度标签。
 * @param label LVGL数值标签对象。
 * @param valid 1表示数据有效，0表示传感器当前不可用。
 * @param value_x10 放大10倍的定点数，308表示30.8。
 * @return 无。
 * @note 全程使用整数运算，避免在STM32上引入浮点格式化开销。
 */
static void APP_UI_UpdateSensorX10(lv_obj_t *label, uint8_t valid,
                                   int32_t value_x10)
{
    int32_t abs_value;

    if (valid == 0U)
    {
        lv_label_set_text(label, "NC");
        return;
    }

    if (value_x10 < 0)
    {
        abs_value = -value_x10;
        lv_label_set_text_fmt(label, "-%ld.%ld",
                              (long)(abs_value / 10L),
                              (long)(abs_value % 10L));
    }
    else
    {
        lv_label_set_text_fmt(label, "%ld.%ld",
                              (long)(value_x10 / 10L),
                              (long)(value_x10 % 10L));
    }
}

/* ********************* Header_StartDefaultTask LVGL UI 交互任务************ */
/**
  * @brief  defaultTask线程用于LVGL UI的更新，以及UI交互事件等
  * @param  argument: 未使用
  * @retval None
  */
void StartDefaultTask(void *argument)
{

	/******************局部变量声明*******************/
	sensor_Data_t recv_data = {0};			//用于接收 xUI_Datas_Queue 中的数据
	sensor_Data_t ui_snapshot = {0};		//用于拷贝一份系统后台读取到的数据，后续通过APP_GetSensorSnapshot在LVGLui中显示
	alarm_output_t alarm_output = {0};		//报警引擎最终输出，用于显示PF10照明灯实际状态
	uint32_t last_ui_refresh = 0UL;			//记录上一次刷新扩展 UI 数据的时间，相当于一个非阻塞软件定时器。控制烟雾、光照、风扇和 IoT 状态每隔约 500ms 刷新一次。
	uint32_t last_ui_value_log = 0UL;		//记录上一次打印 UI 数据日志的时间，用来限制串口日志频率
	uint8_t iot_connected;					//用于暂存 ESP32/OneNET 当前是否在线：1：保持连接onenet，显示 ON；0：没有收到心跳或者已经超时，显示 NC
	APP_Watchdog_Refresh();					//喂狗

	/******************注册回调事件*******************/
	/* 自动照明默认开启；另外两个手动开关默认关闭。 */
	lv_obj_add_state(guider_ui.screen_sw_light, LV_STATE_CHECKED);
	lv_obj_clear_state(guider_ui.screen_sw_buzzer, LV_STATE_CHECKED);
	lv_obj_clear_state(guider_ui.screen_sw_Alarm_light, LV_STATE_CHECKED);
	lv_bar_set_value(guider_ui.screen_bar_fan, 0, LV_ANIM_OFF);
	lv_label_set_text(guider_ui.screen_fan_num, "0%");
	//这三个状态每隔 200ms 交给报警程序：
	g_illumination_enabled = 1U;	//照明灯控制：1为受BH1750光照值自动控制开关PF10
	g_buzzer_manual_sw = 0U;		//蜂鸣器控制：0关，1开（如果发生烟雾报警，报警程序会强制蜂鸣器响。即使这里是 0，烟雾报警也能正常响。）
	g_alarm_light_sw = 0U;			//报警灯控制：0关，1开（如果发生烟雾报警，报警程序会接管红灯，让红灯闪烁。烟雾报警结束后，再恢复手动开关状态）
	custom_update_control_status(false, true, false);//设备控制板块3个状态下方显示开关状态

    lv_obj_add_event_cb(guider_ui.screen_sw_light,//指定控件
						screen_sw_light_event_cb, //指定回调函数
						LV_EVENT_VALUE_CHANGED, //检测控件状态变化
						NULL);

	lv_obj_add_event_cb(guider_ui.screen_sw_buzzer,//指定控件
						screen_sw_buzzer_event_cb, //指定回调函数
						LV_EVENT_VALUE_CHANGED, //检测控件状态变化
						NULL);

	// 新增：报警灯开关回调（test4 UI 新增控件）
	lv_obj_add_event_cb(guider_ui.screen_sw_Alarm_light,//指定控件
						screen_sw_Alarm_light_event_cb, //指定回调函数
						LV_EVENT_VALUE_CHANGED, //检测控件状态变化
						NULL);

	for(;;)
  {
	/******************SHT30温湿度UI更新*******************/
	 // 检查队列中是否有数据（非阻塞，超时时间0）

        if(xQueueReceive(xUI_Datas_Queue, &recv_data, 0)==pdTRUE)//非阻塞
        {
			            // 接收到数据，更新UI（控件名已在 test4 中重命名 *_num）
            /* 最终主题将单位拆成独立标签，此处只更新传感器数值。 */
            APP_UI_UpdateSensorX10(guider_ui.screen_humidity_num,
                                   recv_data.valid_mask & SENSOR_VALID_TEMP_HUMI,
                                   (int32_t)recv_data.humi_x10);
            APP_UI_UpdateSensorX10(guider_ui.screen_temperature_num,
                                   recv_data.valid_mask & SENSOR_VALID_TEMP_HUMI,
                                   (int32_t)recv_data.temp_x10);
        }

		/* 设置页由生成代码按需创建，控件出现后再绑定一次业务回调。 */
		APP_SettingsUI_BindIfReady();

		/* 首页扩展值统一 500 ms 刷新；风扇条只显示报警引擎最终占空比。 */
		if ((uint32_t)(HAL_GetTick() - last_ui_refresh) >= 500UL)
		{
			last_ui_refresh = HAL_GetTick();
			iot_connected = APP_IotHeartbeatCheck(last_ui_refresh);//IOT心跳检查
			APP_GetSensorSnapshot(&ui_snapshot);		//提供数据给UI
			ALARM_GetOutputSnapshot(&alarm_output);		//提供数据给警报仲裁判断
			custom_update_light_output_status(alarm_output.green_led_on != 0U);

			APP_UI_UpdateSensorX10(guider_ui.screen_temperature_num,
							 ui_snapshot.valid_mask & SENSOR_VALID_TEMP_HUMI,
							 (int32_t)ui_snapshot.temp_x10);
			APP_UI_UpdateSensorX10(guider_ui.screen_humidity_num,
							 ui_snapshot.valid_mask & SENSOR_VALID_TEMP_HUMI,
							 (int32_t)ui_snapshot.humi_x10);
			lv_label_set_text_fmt(guider_ui.screen_smoke_num,
							  "%u",
							  (unsigned int)ui_snapshot.smoke_adc);
			APP_UI_UpdateSensorValue(guider_ui.screen_sunlight_num,
							 ui_snapshot.valid_mask & SENSOR_VALID_LIGHT,
							 ui_snapshot.lux);
			lv_label_set_text_fmt(guider_ui.screen_fan_num,
							  "%u%%",
							  (unsigned int)ui_snapshot.fan_pct);
			lv_bar_set_value(guider_ui.screen_bar_fan,
							 (int32_t)ui_snapshot.fan_pct * 10,
							 LV_ANIM_OFF);
			lv_label_set_text(guider_ui.screen_iot_flag,
						  (iot_connected != 0U) ? "ON" : "NC");
			lv_obj_set_style_text_color(guider_ui.screen_iot_flag,
								lv_color_hex((iot_connected != 0U) ? 0x0ac75d : 0xe74c3c),
								LV_PART_MAIN | LV_STATE_DEFAULT);

			/* 新增打印调试内容,测试完成后可删除
			直接读取标签当前文本，确保串口值与屏幕中LVGLui内实际显示值一致。
			 */
			if ((uint32_t)(last_ui_refresh - last_ui_value_log) >= APP_UI_VALUE_LOG_PERIOD_MS)
			{
				last_ui_value_log = last_ui_refresh;
				printf("[UI][DATA][%lu ms] temp=%s C, humi=%s %%, light=%s lx, smoke=%s %%\r\n",
					   (unsigned long)last_ui_refresh,
					   lv_label_get_text(guider_ui.screen_temperature_num),
					   lv_label_get_text(guider_ui.screen_humidity_num),
					   lv_label_get_text(guider_ui.screen_sunlight_num),
					   lv_label_get_text(guider_ui.screen_smoke_num));
			}
		}

		lv_timer_handler(); /* 处理LVGL定时器和任务（必须周期性调用） */

		APP_Watchdog_Refresh();/* 由现有LVGL主循环承担APP存活证明；任务卡死或调度失效时停止喂狗。 */

		osDelay(5);

  }
  /* USER CODE END StartDefaultTask */
}
